## ncs-serial-modem/west.yml
```yaml
manifest:
  projects:
    - name: ncs-serial-modem
      path: ncs-serial-modem
      revision: v1.0.0
      url: https://github.com/nrfconnect/ncs-serial-modem.git
      import: true

  self:
    path: pouch-gateway/ncs-serial-modem
    west-commands: scripts/west-commands.yml
```
